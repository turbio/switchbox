## main/Kconfig.projbuild
```kconfig
menu "Switchbox GPIO Configuration"
    config BUZZER_GPIO
        int "Buzzer GPIO number"
        range 0 39
        default 18

    config DISPLAY_GPIO_RS
        int "GPIO number for the display register select"
        range 0 39
        default 15

    config DISPLAY_GPIO_E
        int "GPIO number for the display read/write signal"
        range 0 39
        default 2

    config DISPLAY_DB_GPIO_4
        int "GPIO number for the display data line 4"
        range 0 39
        default 0

    config DISPLAY_DB_GPIO_5
        int "GPIO number for the display data line 5"
        range 0 39
        default 4

    config DISPLAY_DB_GPIO_6
        int "GPIO number for the display data line 6"
        range 0 39
        default 16

    config DISPLAY_DB_GPIO_7
        int "GPIO number for the display data line 7"
        range 0 39
        default 17

    config SWITCH_GPIO_0
        int "GPIO number for switch 0"
        range 0 39
        default 36

    config SWITCH_GPIO_1
        int "GPIO number for switch 1"
        range 0 39
        default 39

    config SWITCH_GPIO_2
        int "GPIO number for switch 2"
        range 0 39
        default 34

    config SWITCH_GPIO_3
        int "GPIO number for switch 3"
        range 0 39
        default 35

    config SWITCH_GPIO_4
        int "GPIO number for switch 4"
        range 0 39
        default 32

    config SWITCH_GPIO_5
        int "GPIO number for switch 5"
        range 0 39
        default 33

    config SWITCH_GPIO_6
        int "GPIO number for switch 6"
        range 0 39
        default 25

    config SWITCH_GPIO_7
        int "GPIO number for switch 7"
        range 0 39
        default 26
endmenu
```
